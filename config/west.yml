## config/west.yml
```yaml
manifest:
  defaults:
    revision: main
  remotes:
    - name: zmkfirmware
      url-base: https://github.com/zmkfirmware
    - name: BildermanKawasaki
      url-base: https://github.com/BildermanKawasaki
    - name: urob
      url-base: https://github.com/urob
  projects:
    - name: zmk
      remote: zmkfirmware
      revision: v0.3
      import: app/west.yml

      # device and drivenr modules
    - name: zmk-keyboard-totem
      remote: BildermanKawasaki 

      # urob modules
    - name: zmk-adaptive-key
      remote: urob
      revision: v0.3
      path: modules/zmk/adaptive-key
    - name: zmk-auto-layer
      remote: urob
      revision: v0.3
      path: modules/zmk/auto-layer
    - name: zmk-helpers
      remote: urob
      revision: v0.3
      path: modules/zmk/helpers
    - name: zmk-leader-key
      remote: urob
      revision: v0.3
      path: modules/zmk/leader-key
    - name: zmk-tri-state
      remote: urob
      revision: v0.3
      path: modules/zmk/tri-state
    - name: zmk-unicode
      remote: urob
      revision: v0.3
      path: modules/zmk/unicode
  self:
    path: config
  
```
